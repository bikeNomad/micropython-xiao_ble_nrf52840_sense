/delete-node/ &storage_partition;

// 16Mib (2MiB) flash
&p25q16h {
	partitions {
		compatible = "fixed-partitions";
		#address-cells = <1>;
		#size-cells = <1>;

		storage_partition: partition@0 {
			label = "ExtStorage";
			reg = <0x00000000 0x200000>;
		};
	};
};

// change 0 to 1 to enable MEMS microphone
#if 0
/ {
	msm261d3526hicpm-c-en {
		regulator-boot-on;
	};
};

dmic_dev: &pdm0 {
	status = "okay";
};
#endif